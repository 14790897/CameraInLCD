## sdkconfig.defaults
```kconfig
# ESP32-S3 Camera LCD Display Project Configuration

# PSRAM Configuration
CONFIG_SPIRAM=y
CONFIG_SPIRAM_SPEED_200M=y
CONFIG_SPIRAM_FETCH_INSTRUCTIONS=y
CONFIG_SPIRAM_RODATA=y

# Camera Configuration
CONFIG_IDF_EXPERIMENTAL_FEATURES=y
CONFIG_CAMERA_OV7670=y

# FreeRTOS Configuration
CONFIG_FREERTOS_HZ=1000

# Log Configuration
CONFIG_LOG_MAXIMUM_LEVEL=3
CONFIG_LOG_DEFAULT_LEVEL=3
CONFIG_LOG_COLORS=y

# SPI Configuration
CONFIG_SPI_MASTER_ISR_IN_IRAM=y

# LCD Configuration
CONFIG_LCD_ENABLE_DEBUG_LOG=y

# Memory Configuration
CONFIG_ESP_SYSTEM_ALLOW_RTC_FAST_MEM_AS_HEAP=y

# Performance optimizations
CONFIG_COMPILER_OPTIMIZATION_PERF=y
CONFIG_ESP_DEFAULT_CPU_FREQ_MHZ_240=y
CONFIG_ESP_DEFAULT_CPU_FREQ_MHZ=240
```
